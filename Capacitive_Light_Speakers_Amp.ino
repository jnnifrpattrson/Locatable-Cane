#include <Wire.h>
#include <Adafruit_GFX.h>
#include <Adafruit_IS31FL3731.h>
#include <Wire.h>
#include "Adafruit_MPR121.h"
#include "SPI.h"
#include <PCM.h>
#include "Adafruit_BLE_UART.h"

//#include <Adafruit_LIS3DH.h>
//#include <Adafruit_Sensor.h>

// Used for software SPI
//#define LIS3DH_CLK 7
//#define LIS3DH_MISO 6
//#define LIS3DH_MOSI 5
// Used for hardware & software SPI
//#define LIS3DH_CS 4

// Connect CLK/MISO/MOSI to hardware SPI
// e.g. On UNO & compatible: CLK = 13, MISO = 12, MOSI = 11
#define ADAFRUITBLE_REQ 53
#define ADAFRUITBLE_RDY 2     // This should be an interrupt pin, on Uno thats #2 or #3
#define ADAFRUITBLE_RST 9

// If you're using the full breakout...
Adafruit_IS31FL3731 ledmatrix = Adafruit_IS31FL3731();
// If you're using the FeatherWing version
//Adafruit_IS31FL3731_Wing ledmatrix = Adafruit_IS31FL3731_Wing();

//Adafruit_LIS3DH lis = Adafruit_LIS3DH(LIS3DH_CS, LIS3DH_MOSI, LIS3DH_MISO, LIS3DH_CLK);

Adafruit_BLE_UART BTLEserial = Adafruit_BLE_UART(ADAFRUITBLE_REQ, ADAFRUITBLE_RDY, ADAFRUITBLE_RST);

//#if defined(ARDUINO_ARCH_SAMD)
   //#define Serial SerialUSB
//#endif

//#define CLICKTHRESHHOLD 80

// The lookup table to make the brightness changes be more visible
uint8_t sweep[] = {1, 2, 3, 4, 6, 8, 10, 15, 20, 30, 40, 60, 60, 40, 30, 20, 15, 10, 8, 6, 4, 3, 2, 1};

const unsigned char sample[] PROGMEM = {
129, 128, 128, 128, 127, 127, 127, 127, 126, 127, 128, 128,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 127, };

//Capacitive Touch

// You can have up to 4 on one i2c bus but one is enough for testing!
Adafruit_MPR121 cap = Adafruit_MPR121();
boolean iftouched = false;
boolean lighton = false;
// Keeps track of the last pins touched
// so we know when buttons are 'released'
uint16_t lasttouched = 0;
uint16_t currtouched = 0;

void setup() {

//LED  

  Serial.begin(9600);
  while(!Serial); // Leonardo/Micro should wait for serial init
  Serial.println(F("Adafruit Bluefruit Low Energy nRF8001 Print echo demo"));

  // BTLEserial.setDeviceName("NEWNAME"); /* 7 characters max! */
  BTLEserial.begin();
  
  Serial.println("LED Initialized");
  if (! ledmatrix.begin()) {
    Serial.println("LED not Found");
    while (1);
  }
  Serial.println("LED Found!");

//Capacitive Touch Sensor

  cap.begin(0x5A);
  Serial.println("Capacitive Touch Sensor Initialized"); 
  
  if (!cap.begin(0x5A)) {
    Serial.println("Capacitive Touch Senesor not found, check wiring?");
    while (1);
  }
  Serial.println("Capacitive Touch Sensor Found!");
  
}

/**************************************************************************/
/*!
    Constantly checks for new events on the nRF8001
*/
/**************************************************************************/
aci_evt_opcode_t laststatus = ACI_EVT_DISCONNECTED;
int trig = 0;
// boolean b = false;
void loop() {
  // Tell the nRF8001 to do whatever it should be working on.
  BTLEserial.pollACI();

  // Ask what is our current status
  aci_evt_opcode_t status = BTLEserial.getState();
  // If the status changed....
  if (status != laststatus) {
    // print it out!
    if (status == ACI_EVT_DEVICE_STARTED) {
        Serial.println(F("* Advertising started"));
    }
    if (status == ACI_EVT_CONNECTED) {
        Serial.println(F("* Connected!"));
    }
    if (status == ACI_EVT_DISCONNECTED) {
        Serial.println(F("* Disconnected or advertising timed out"));
    }
    // OK set the last status change to this one
    laststatus = status;
  }

  if (status == ACI_EVT_CONNECTED) {
    // Lets see if there's any data for us!
    if (BTLEserial.available()) {
      Serial.print("* "); Serial.print(BTLEserial.available()); Serial.println(F(" bytes available from BTLE"));
    }
      // OK while we still have something to read, get a character and print it out
      while (BTLEserial.available()) {
        char c = BTLEserial.read();
        Serial.print(c);
        Serial.print("\n");
        trig = c - '0';
        Serial.print(trig);
      }
  }

  if (trig) {
    Serial.write(trig); //Write the serial data
    //startPlayback(sample, sizeof(sample));
    for (uint8_t incr = 0; incr < 24; incr++)
      for (uint8_t x = 0; x < 16; x++)
        for (uint8_t y = 0; y < 9; y++)
          ledmatrix.drawPixel(x, y, 150);
          lighton = true;
          iftouched=true;
  } 
  /*if (cap.touched() && (1 << 7) | (1<<2)){
      Serial.write(0); //Write the serial data
      //stopPlayback();
      for (uint8_t incr = 0; incr < 24; incr++)
        for (uint8_t x = 0; x < 16; x++)
          for (uint8_t y = 0; y < 9; y++)
            ledmatrix.drawPixel(x, y, 0);
            iftouched=false;
            Serial.println("here");
            trig = 0;
  }*/

  if ((cap.touched() && (1 << 7) | (1<<2)) && lighton == true){
    for (uint8_t incr = 0; incr < 24; incr++)
      for (uint8_t x = 0; x < 16; x++)
        for (uint8_t y = 0; y < 9; y++)
          ledmatrix.drawPixel(x, y, 0);
          iftouched=true;
          lighton = false;
          trig = 0;
  } 
  
  if((cap.touched() && (1 << 7) | (1<<2)) && lighton == false){
    for (uint8_t incr = 0; incr < 24; incr++)
      for (uint8_t x = 0; x < 16; x++)
        for (uint8_t y = 0; y < 9; y++)
          ledmatrix.drawPixel(x, y, 130);
          lighton = true;
          iftouched = false;
          trig = 0;
  }

}